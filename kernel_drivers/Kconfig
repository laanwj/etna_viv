## kernel_drivers/Kconfig
```kconfig
choice
	prompt "Vivante GPUs"
	depends on ARCH_DMW
	default GPU_VIVANTE_V4
	optional

config GPU_VIVANTE_V2
	boolean "Version 2.x"

config GPU_VIVANTE_V4
	boolean "Version 4.x"

endchoice

source "drivers/gpu/vivante/v2/Kconfig"
source "drivers/gpu/vivante/v4/Kconfig"
```

## kernel_drivers/v2/Kconfig
```kconfig
if GPU_VIVANTE_V2

menu "Vivante Options"

config GPU_VIVANTE_ANDROID
	bool
	default y if ANDROID
	default n

config GPU_VIVANTE_DEBUG
	boolean "Enable debug output"

config GPU_VIVANTE_PROFILER
	boolean "Enable profiler"

config GPU_VIVANTE_NEWSIGNAL
	boolean "Use new linux signal"

endmenu

endif
```

## kernel_drivers/v4/Kconfig
```kconfig
if GPU_VIVANTE_V4

menu "Vivante Options"

config GPU_VIVANTE_ANDROID
	bool
	default y if ANDROID
	default n

config GPU_VIVANTE_DEBUG
	boolean "Enable debug output"

config GPU_VIVANTE_PROFILER
	boolean "Enable profiler"

config GPU_VIVANTE_NEWSIGNAL
	boolean "Use new linux signal"

config GPU_VIVANTE_NO_DMA_COHERENT
	boolean "Disable coherent DMA function"

config GPU_VIVANTE_POWER_MANAGEMENT
	boolean "Enable power management"
	default y

endmenu

endif
```
